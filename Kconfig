## Kconfig
```kconfig
# SPDX-FileCopyrightText: 2025 Alicipy <dev@stefankraus.org>
#
# SPDX-License-Identifier: Apache-2.0

rsource "drivers/Kconfig"

rsource "lib/Kconfig"

rsource "subsys/Kconfig"
```

## boards/extensions/coffeecaller_nrf52/coffeecaller_nrf52_defconfig
```kconfig
# SPDX-FileCopyrightText: 2025 Alicipy <dev@stefankraus.org>
#
# SPDX-License-Identifier: Apache-2.0

CONFIG_PWM=y
CONFIG_LED_STRIP=y
```

## boards/tiac/coffeecaller/board.yml
```yaml
# SPDX-FileCopyrightText: 2025 andreaskurz
#
# SPDX-License-Identifier: Apache-2.0

board:
  name: tiac_coffeecaller
  full_name: TiaC Systems CoffeeCaller
  vendor: tiac
  socs:
  - name: nrf52840
```

## boards/tiac/coffeecaller/tiac_coffeecaller_nrf52840_defconfig
```kconfig
# Copyright (c) 2025 TiaC Systems
# SPDX-License-Identifier: Apache-2.0

CONFIG_NRFX_CLOCK_LFXO_TWO_STAGE_ENABLED=n
CONFIG_CLOCK_CONTROL_NRF_K32SRC_RC=y

# Build UF2 by default, supported by the Adafruit nRF52 Bootloader
CONFIG_BUILD_OUTPUT_UF2=y
CONFIG_USE_DT_CODE_PARTITION=y

# Enable MPU
CONFIG_ARM_MPU=y

# Enable hardware stack protection
CONFIG_HW_STACK_PROTECTION=y

# enable uart driver
CONFIG_SERIAL=y

# enable console
CONFIG_CONSOLE=y
CONFIG_UART_CONSOLE=y

# enable peripherals
CONFIG_GPIO=y
CONFIG_I2C=y
CONFIG_SPI=y
CONFIG_PWM=y
CONFIG_LED_STRIP=y

# enable watchdog
CONFIG_WATCHDOG=y
CONFIG_WDT_DISABLE_AT_BOOT=n

CONFIG_USB_DEVICE_INITIALIZE_AT_BOOT=y
CONFIG_USB_DEVICE_STACK=y
CONFIG_USB_DEVICE_PRODUCT="TiaC CoffeeCaller"
CONFIG_USB_DEVICE_PID=0x0004
CONFIG_USB_DEVICE_VID=0x1337
CONFIG_USB_CDC_ACM_LOG_LEVEL_OFF=y

# configure LED strip timings
#CONFIG_DELAY_T1H=50
#CONFIG_DELAY_T1L=50
#CONFIG_DELAY_T0H=20
#CONFIG_DELAY_T0L=50
```

## drivers/Kconfig
```kconfig
# SPDX-FileCopyrightText: 2025 Alicipy <dev@stefankraus.org>
#
# SPDX-License-Identifier: Apache-2.0

menu "Device Drivers"

rsource "led_strip/Kconfig"
rsource "pwm/Kconfig"

endmenu
```

## drivers/led_strip/Kconfig
```kconfig
# SPDX-FileCopyrightText: 2025 Alicipy <dev@stefankraus.org>
#
# SPDX-License-Identifier: Apache-2.0

config FAKE_LED_STRIP
	bool "Fake LED STRIP"
	default y
	depends on DT_HAS_ZEPHYR_FAKE_LED_STRIP_ENABLED
	help
      Enable support for the fake LED strip.
```

## drivers/pwm/Kconfig
```kconfig
# SPDX-FileCopyrightText: 2025 Alicipy <dev@stefankraus.org>
#
# SPDX-License-Identifier: Apache-2.0

config PWM_NATIVE_SIM
	bool "Fake PWM driver"
	default y
	depends on DT_HAS_ZEPHYR_PWM_NATIVE_SIM_ENABLED
	help
      Enable support for a logging dummy PWM driver.
```

## dts/bindings/led_strip/zephyr,fake-led-strip.yaml
```yaml
# SPDX-FileCopyrightText: 2025 Alicipy <dev@stefankraus.org>
#
# SPDX-License-Identifier: Apache-2.0

description: |
  A fake LED strip driver for testing purposes in Zephyr.
  This binding describes a simulated LED strip with a configurable number
  of chained LEDs.

compatible: "zephyr,fake-led-strip"

include: [led-strip.yaml]
```

## lib/Kconfig
```kconfig
# SPDX-FileCopyrightText: 2025 Alicipy <dev@stefankraus.org>
#
# SPDX-License-Identifier: Apache-2.0

menu "Coffee Caller Libraries"

config CC_LIB
    bool "Activates the CoffeeCall library"
    default n

endmenu
```

## subsys/Kconfig
```kconfig
# SPDX-FileCopyrightText: 2025 Alicipy <dev@stefankraus.org>
#
# SPDX-License-Identifier: Apache-2.0

rsource "cc_broadcast/Kconfig"
rsource "cc_coffeecall/Kconfig"
rsource "cc_temperature/Kconfig"
```

## subsys/cc_broadcast/Kconfig
```kconfig
menu "CoffeeCaller Broadcast Subsystem"
    config CC_BROADCAST_SUBSYS
        bool "Enable CoffeeCaller Broadcast Subsystem"
        select NETWORKING
        select HW_INFO
        select JSON_LIBRARY
        default n

    config CC_BROADCAST_SUBSYS_MAX_CLIENTS
        int "Maximum number of CoffeeCaller Broadcast clients"
        range 1 32
        default 8
        help
          This option sets the maximum number of clients that can be registered
          with the CoffeeCaller Broadcast subsystem. Adjust based on expected usage.

    config CC_BROADCAST_SUBSYS_MAX_TYPE_LEN
        int "Maximum length of broadcast type"
        range 1 32
        default 16
        help
          This option sets the maximum length of the broadcast type string.
          It should be sufficient to accommodate the expected broadcast type names.

    config CC_BROADCAST_SUBSYS_MAX_PAYLOAD_LEN
        int "Maximum length of broadcast payload"
        default 128
        help
          This option sets the maximum length of the broadcast message payload that can be
          handled by the CoffeeCaller Broadcast subsystem. It should be large enough
          to accommodate the expected payload sizes.

    choice CC_BROADCAST_SUBSYS_TRANSPORT
        prompt "Transport used to send and receive messages"
        default TRANSPORT_LOCALQUEUE if BOARD_NATIVE_SIM
        default TRANSPORT_OPENTHREAD if !BOARD_NATIVE_SIM
        help
          Select the backend transport mechanism used by the broadcast subsystem
          for sending and receiving messages.

    config TRANSPORT_OPENTHREAD
        bool "OpenThread transport"
        select OPENTHREAD_COAP
        select NET_L2_OPENTHREAD
        help
          Use OpenThread to send and receive messages between nodes.

    config TRANSPORT_LOCALQUEUE
        bool "Local queue transport"
        help
          Use a local software queue to send and receive messages.
          No actual network communication will occur.
    endchoice

    # Set some default values for OpenThread
    if TRANSPORT_OPENTHREAD

    config OPENTHREAD_PING_SENDER
        bool
        default y

    config OPENTHREAD_PANID
        int
        default 1631

    config OPENTHREAD_XPANID
        string
        default "c0:ff:ee:11:22:33:44:55"

    config OPENTHREAD_NETWORKKEY
        string
        default "c0:ff:ee:ca:ll:ee:aa:bb:cc:dd:ee:ff:cc:c0:ff:ee"

    config OPENTHREAD_CHANNEL
        int
        default 15

    config OPENTHREAD_NETWORK_NAME
        string
        default "CoffeeCaller"

    endif # TRANSPORT_OPENTHREAD

endmenu
```

## subsys/cc_coffeecall/Kconfig
```kconfig
menu "CC CoffeeCall Subsystem"
    config CC_COFFEECALL_SUBSYS
        bool "Enable CoffeeCaller CoffeeCall Subsystem"
        select CC_LIB
        select CC_BROADCAST_SUBSYS
        select SMF
        select EVENTS
        select WATCHDOG
        default n

    if CC_COFFEECALL_SUBSYS

    menu "CoffeeCall configuration"

    config CC_COFFEECALL_SUBSYS_SHELL
        select SHELL
        bool "Enable CoffeeCall Subsys Shell"
        default n

    config CC_COFFEECALL_CALL_ACTIVE_TIMEOUT
       int "How many seconds the coffee caller should wait before signaling yay or nay"
       default 30

    endmenu

    endif # CC_COFFEECALL_SUBSYS

endmenu
```

## subsys/cc_temperature/Kconfig
```kconfig
menu "CC Temperature Subsystem"
    config CC_TEMPERATURE_SUBSYS
        bool "Enable CoffeeCaller Broadcast Subsystem"
        select CC_BROADCAST_SUBSYS
        select CBPRINTF_FP_SUPPORT
        default n
        
    if CC_TEMPERATURE_SUBSYS

    menu "Temperature sensor configuration"

    choice CC_TEMPERATURE_SENSOR
        prompt "Select temperature sensor type"
        default CC_TEMPERATURE_SENSOR_FAKE if BOARD_NATIVE_SIM
        default CC_TEMPERATURE_SENSOR_DHT if !BOARD_NATIVE_SIM

    config CC_TEMPERATURE_SENSOR_DHT
        bool "DHT temperature sensor"
        select CONFIG_SENSOR
        select CONFIG_SHT4X
        select CONFIG_I2C
        help
          Enable DHT temperature sensor support

    config CC_TEMPERATURE_SENSOR_FAKE
        bool "Fake temperature sensor"
        help
          Enable fake temperature sensor for testing

    endchoice

    endmenu

    endif # CC_TEMPERATURE_SUBSYS

endmenu
```

## tests/lib/cc_lib/testcase.yaml
```yaml
# SPDX-FileCopyrightText: 2025 Alicipy <dev@stefankraus.org>
#
# SPDX-License-Identifier: Apache-2.0

tests:
  aldrin.buzzer:
    platform_allow: native_sim
    tags:
    - aldrin
    - cc_lib
```

## tests/subsys/cc_broadcast/testcase.yaml
```yaml
# SPDX-FileCopyrightText: 2025 Alicipy <dev@stefankraus.org>
#
# SPDX-License-Identifier: Apache-2.0

common:
  tags: cc_broadcast
  harness: ztest

tests:
  subsys.cc_broadcast.basic_executable:
    platform_allow:
      - native_sim
    integration_platforms:
      - native_sim
  subsys.cc_broadcast.test_compilable:
    #depends_on: openthread
    platform_allow:
      - tiac_coffeecaller
      - coffeecaller_nrf52/nrf52840
    integration_platforms:
      - tiac_coffeecaller
      - coffeecaller_nrf52/nrf52840
```

## tests/subsys/cc_coffeecall/testcase.yaml
```yaml
common:
  tags: cc_coffeecall
  platform_allow:
    - native_sim
    - tiac_coffeecaller
  integration_platforms:
    - native_sim
    - tiac_coffeecaller
  harness: shell


tests:
  subsys.cc_coffeecall.shell.pressed_no_response:
    harness_config:
      shell_commands:
        - command: cc press_button
        - command: kernel sleep 1500
          expected: ".*announcing 'no'"
  subsys.cc_coffeecall.shell.pressed_got_response:
    harness_config:
      shell_commands:
        - command: cc press_button
        - command: cc recv_take_part_msg 123 1
        - command: kernel sleep 1500
          expected: ".*announcing 'yes'"
  subsys.cc_coffeecall.shell.got_single_recv_message_only:
    harness_config:
      shell_commands:
        - command: cc recv_take_part_msg 123 1
        - command: kernel sleep 1500
          expected: ".*announcing 'no'"
  subsys.cc_coffeecall.shell.got_two_recv_messages_not_pressing:
    harness_config:
      shell_commands:
        - command: cc recv_take_part_msg 123 1
        - command: kernel sleep 1500
          expected: ".*announcing 'no'"
  subsys.cc_coffeecall.shell.got_recv_message_taking_part:
    harness_config:
      shell_commands:
        - command: cc recv_take_part_msg 123 1
        - command: kernel sleep 200
        - command: cc press_button
        - command: kernel sleep 1000
          expected: ".*announcing 'yes'"
  subsys.cc_coffeecall.shell.got_two_recv_messages_not_pressing:
    harness_config:
      shell_commands:
        - command: cc recv_take_part_msg 123 1
        - command: kernel sleep 200
        - command: cc recv_take_part_msg 456 1
        - command: kernel sleep 1000
          expected: ".*announcing 'yes'"
```

## west.yml
```yaml
# SPDX-FileCopyrightText: 2025 Alicipy <dev@stefankraus.org>
#
# SPDX-License-Identifier: Apache-2.0

manifest:
  remotes:
    - name: zephyrproject-rtos
      url-base: https://github.com/zephyrproject-rtos

  projects:
    - name: zephyr
      remote: zephyrproject-rtos
      revision: v4.2.0
      clone-depth: 1
      import:
        name-allowlist:
          - cmsis_6
          - hal_st # for ST sensors
          - hal_nordic
          - libmetal
          - mbedtls
          - mcuboot
          - open-amp
          - openthread
```
