## CMakeLists.txt
```
# SPDX-FileCopyrightText: 2025 Alicipy <dev@stefankraus.org>
#
# SPDX-License-Identifier: Apache-2.0

cmake_minimum_required(VERSION 3.20.0)
find_package(Zephyr REQUIRED HINTS $ENV{ZEPHYR_BASE})
project(coffeecaller_app)

target_sources(app PRIVATE
        ./src/main.c
)
```

## sample.yaml
```
# SPDX-FileCopyrightText: 2025 Alicipy <dev@stefankraus.org>
#
# SPDX-License-Identifier: Apache-2.0

sample:
  name: CC CoffeeCall App
  description: App that combines the subsystems for the coffeecaller.
common:
  integration_platforms:
  - native_sim/native/coffeecaller
  - coffeecaller_nrf52/nrf52840
tests:
  app.coffeecaller:
    build_only: true
```

## prj.conf
```kconfig
# SPDX-FileCopyrightText: 2025 Alicipy <dev@stefankraus.org>
#
# SPDX-License-Identifier: Apache-2.0

CONFIG_LOG=y
CONFIG_LOG_DEFAULT_LEVEL=2

# all CC subsystems
CONFIG_CC_COFFEECALL_SUBSYS=y
CONFIG_CC_TEMPERATURE_SUBSYS=y

# Kernel options
CONFIG_INIT_STACKS=y
CONFIG_MAIN_STACK_SIZE=2560
CONFIG_HEAP_MEM_POOL_SIZE=65536
CONFIG_SYSTEM_WORKQUEUE_STACK_SIZE=2048
```

## src/main.c
```c
/*
 * SPDX-FileCopyrightText: 2025 Alicipy <dev@stefankraus.org>
 *
 * SPDX-License-Identifier: Apache-2.0
 */

int main(void){}
```
