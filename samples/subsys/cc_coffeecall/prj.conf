## CMakeLists.txt
```
# SPDX-FileCopyrightText: 2025 Alicipy <dev@stefankraus.org>
#
# SPDX-License-Identifier: Apache-2.0

cmake_minimum_required(VERSION 3.20.0)

find_package(Zephyr REQUIRED HINTS $ENV{ZEPHYR_BASE})

project(cc_coffeecall_shell_sample)

target_sources(app PRIVATE
  ${CMAKE_CURRENT_LIST_DIR}/src/main.c
)
```

## sample.yaml
```
# SPDX-FileCopyrightText: 2025 Alicipy <dev@stefankraus.org>
#
# SPDX-License-Identifier: Apache-2.0

sample:
  name: CC CoffeeCall Subsystem Sample
  description: Sample to interact with the CoffeeCall subsystem via Shell commands on supported boards.
common:
  build_only: true
  integration_platforms:
  - native_sim/native/coffeecaller
  - coffeecaller_nrf52/nrf52840
tests:
  cc_coffeecall.sample: {}
```

## prj.conf
```kconfig
# SPDX-FileCopyrightText: 2025 Alicipy <dev@stefankraus.org>
#
# SPDX-License-Identifier: Apache-2.0

CONFIG_LOG=y
CONFIG_LOG_DEFAULT_LEVEL=3

# CC CoffeeCall subsystem
CONFIG_CC_COFFEECALL_SUBSYS=y
CONFIG_CC_COFFEECALL_SUBSYS_SHELL=y

# Kernel options
CONFIG_MAIN_STACK_SIZE=2560
CONFIG_INIT_STACKS=y
CONFIG_HEAP_MEM_POOL_SIZE=65536

CONFIG_PRINTK=y

CONFIG_SHELL=y
CONFIG_SERIAL=y
```

## boards/native_sim.conf
```kconfig
# SPDX-FileCopyrightText: 2025 Alicipy <dev@stefankraus.org>
#
# SPDX-License-Identifier: Apache-2.0

CONFIG_UART_NATIVE_PTY_0_ON_STDINOUT=y
```

## src/main.c
```c
/*
 * SPDX-FileCopyrightText: 2025 Alicipy <dev@stefankraus.org>
 *
 * SPDX-License-Identifier: Apache-2.0
 */

int main(void) {
    return 0;
}
```
